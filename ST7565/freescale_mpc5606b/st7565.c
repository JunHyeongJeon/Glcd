/*
 * st7565.c
 *
 *  Created on: Jun 30, 2015
 *      Author: Jun
 */
#include "st7565.h"


const uint8_t pagemap[] = { 3, 2, 1, 0, 7, 6, 5, 4 };

#define ST7565_STARTBYTES 1


// the memory buffer for the LCD
uint8_t st7565_buffer[1024] = { 
0x0, 0x0, 0x0, 0x0, 0x0, 0x0, 0x0, 0x0, 0x0, 0x0, 0x0, 0x0, 0x0, 0x0, 0x0, 0x0, 
0x0, 0x0, 0x0, 0x0, 0x0, 0x0, 0x0, 0x0, 0x0, 0x0, 0x0, 0x0, 0x0, 0x0, 0x0, 0x0, 
0x0, 0x0, 0x0, 0x0, 0x0, 0x0, 0x0, 0x0, 0x0, 0x0, 0x0, 0x0, 0x0, 0x0, 0x0, 0x0, 
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0x0, 0x0, 0x0, 0x0, 0x0, 0x0, 0x0, 0x0, 0x0, 0x0, 0x0, 0x0, 0x0, 0x0, 0x0, 0x0,};




void glcd_begin(uint8_t contrast) {
  st7565_init();
  st7565_command(CMD_DISPLAY_ON);
  st7565_command(CMD_SET_ALLPTS_NORMAL);
  st7565_set_brightness(contrast);
}

inline void spiwrite(uint8_t c){
	int8_t i;
	for (i=7; i>=0; i--) {
		SIU.GPDO[PIN_GLCD_SCLK].B.PDO &= 0;
	    if (c & _BV(i))
	    	SIU.GPDO[PIN_GLCD_SID].B.PDO |= 1;
	    else
	    	SIU.GPDO[PIN_GLCD_SID].B.PDO &= 0;
		SIU.GPDO[PIN_GLCD_SCLK].B.PDO |= 1;	
	}
	  
}

void st7565_init(void){
	SIU.PCR[PIN_GLCD_CS].R = OUTPUT; 
    SIU.PCR[PIN_GLCD_RST].R = OUTPUT;
    SIU.PCR[PIN_GLCD_AO].R = OUTPUT;
    SIU.PCR[PIN_GLCD_SID].R = OUTPUT;
    SIU.PCR[PIN_GLCD_SCLK].R = OUTPUT;
                
    	
    if(PIN_GLCD_CS > 0)
    	GPIO_SetState(PIN_GLCD_CS, LOW);
    
    GPIO_SetState(PIN_GLCD_RST, LOW);
    sdelay(1);
    GPIO_SetState(PIN_GLCD_RST, HIGH);
    
	// LCD bias select
	st7565_command(CMD_SET_BIAS_7);
	// ADC select
	st7565_command(CMD_SET_ADC_NORMAL);
	// SHL select
	st7565_command(CMD_SET_COM_NORMAL);
	// Initial display line
	st7565_command(CMD_SET_DISP_START_LINE);
	
	// turn on voltage converter (VC=1, VR=0, VF=0)
	st7565_command(CMD_SET_POWER_CONTROL | 0x4);
	// wait for 50% rising
	mdelay(200);
	
	// turn on voltage regulator (VC=1, VR=1, VF=0)
	st7565_command(CMD_SET_POWER_CONTROL | 0x6);
	// wait >=50ms
	mdelay(200);
	
	// turn on voltage follower (VC=1, VR=1, VF=1)
	st7565_command(CMD_SET_POWER_CONTROL | 0x7);
	// wait
	mdelay(40);
	
	// set lcd operating voltage (regulator resistor, ref voltage resistor)
	st7565_command(CMD_SET_RESISTOR_RATIO | 0x6);
	
	// initial display line
	// set page address
	// set column address
	// write display data

	updateBoundingBox(0, 0, LCDWIDTH-1, LCDHEIGHT-1);
}


void st7565_command(uint8_t c){
	SIU.GPDO[PIN_GLCD_AO].B.PDO &=0;
	spiwrite(c);
}
void st7565_data(uint8_t c){
	SIU.GPDO[PIN_GLCD_AO].B.PDO |=1;
	spiwrite(c);
}

void st7565_set_brightness(uint8_t val) {
    st7565_command(CMD_SET_VOLUME_FIRST);
    st7565_command(CMD_SET_VOLUME_SECOND | (val & 0x3f));
}


void glcd_clear_screen(void) {
 /* uint8_t p, c;
  
  for(p = 0; p < 8; p++) {
    

    st7565_command(CMD_SET_PAGE | p);
    for(c = 0; c < 129; c++) {
      //uart_putw_dec(c);
      //uart_putchar(' ');
      st7565_command(CMD_SET_COLUMN_LOWER | (c & 0xf));
      st7565_command(CMD_SET_COLUMN_UPPER | ((c >> 4) & 0xf));
      st7565_data(0x0);
    }     
  }*/
	
	int i, j;
	for ( i=0; i < LCDWIDTH; i++){
		for ( j=0; j < LCDHEIGHT; j++){
			setpixel(i, j, WHITE);
		}
	}
}



void write_buffer(uint8_t *buffer);

void testdrawbitmap(uint8_t *buff, const uint8_t *bitmap, uint8_t w, uint8_t h);

void glcd_display(void) {
	uint8_t col, maxcol, p;

	for(p = 0; p < 8; p++) {
			
		#ifdef enablePartialUpdate
			// check if this page is part of update
			if ( yUpdateMin >= ((p+1)*8) ) {
			  continue;   // nope, skip it!
			}
			if (yUpdateMax < p*8) {
			  break;
			}
		#endif
		
		st7565_command(CMD_SET_PAGE | pagemap[p]);
		
		
		#ifdef enablePartialUpdate
			col = xUpdateMin;
			maxcol = xUpdateMax;
			#else
				// start at the beginning of the row
				col = 0;
			maxcol = LCDWIDTH-1;
		#endif
		
		st7565_command(CMD_SET_COLUMN_LOWER | ((col+ST7565_STARTBYTES) & 0xf));
		st7565_command(CMD_SET_COLUMN_UPPER | (((col+ST7565_STARTBYTES) >> 4) & 0x0F));
		st7565_command(CMD_RMW);
		
		for(; col <= maxcol; col++) {
		  //uart_putw_dec(col);
		  //uart_putchar(' ');
		  st7565_data(st7565_buffer[(128*p)+col]);
		}
	}

	#ifdef enablePartialUpdate
	  xUpdateMin = LCDWIDTH - 1;
	  xUpdateMax = 0;
	  yUpdateMin = LCDHEIGHT-1;
	  yUpdateMax = 0;
	#endif
}



void updateBoundingBox(uint8_t xmin, uint8_t ymin, uint8_t xmax, uint8_t ymax) {
	
	#ifdef enablePartialUpdate
		if (xmin < xUpdateMin) xUpdateMin = xmin;
		if (xmax > xUpdateMax) xUpdateMax = xmax;
		if (ymin < yUpdateMin) yUpdateMin = ymin;
		if (ymax > yUpdateMax) yUpdateMax = ymax;
	#endif
		
}

void setpixel(uint8_t x, uint8_t y, uint8_t color) {
  if ((x >= LCDWIDTH) || (y >= LCDHEIGHT))
    return;

  // x is which column
  if (color) 
    st7565_buffer[x+ (y/8)*128] |= _BV(7-(y%8));  
  else
    st7565_buffer[x+ (y/8)*128] &= ~_BV(7-(y%8)); 

  updateBoundingBox(x,y,x,y);
}
